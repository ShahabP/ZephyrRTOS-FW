## CMakeLists.txt
```
cmake_minimum_required(VERSION 3.20.0)
find_package(Zephyr REQUIRED HINTS $ENV{ZEPHYR_BASE})
project(fhr_monitor)

target_sources(app PRIVATE
    src/main.c
    src/ble/bas_service.c
    src/ble/fhr_service.c
    src/tasks/battery_task.c
    src/tasks/fhr_task.c
    src/sim/battery_sim.c
    src/sim/fhr_sim.c
)

target_include_directories(app PRIVATE src)
```

## prj.conf
```kconfig
CONFIG_BT=y
CONFIG_BT_PERIPHERAL=y
CONFIG_BT_DEVICE_NAME="FHR_MONITOR"
CONFIG_BT_BAS=y
CONFIG_BT_GATT_DYNAMIC_DB=y
CONFIG_LOG=y
```

## src/main.c
```c
#include <zephyr.h>
#include <sys/printk.h>
#include <string.h>
#include <bluetooth/bluetooth.h>
#include <bluetooth/hci.h>
#include <bluetooth/conn.h>
#include "ble/bas_service.h"
#include "ble/fhr_service.h"

static void connected(struct bt_conn *conn, uint8_t err)
{
    if (err) {
        printk("Connection failed (err %u)\n", err);
    } else {
        printk("Connected\n");
    }
}

static void disconnected(struct bt_conn *conn, uint8_t reason)
{
    printk("Disconnected (reason %u), restarting advertising\n", reason);
    bt_le_adv_start(BT_LE_ADV_CONN, NULL, 0, NULL, 0);
}

static struct bt_conn_cb conn_callbacks = {
    .connected = connected,
    .disconnected = disconnected,
};

void main(void)
{
    int err;

    err = bt_enable(NULL);
    if (err) {
        printk("Bluetooth init failed (err %d)\n", err);
        return;
    }

    printk("Bluetooth initialized\n");

    bt_conn_cb_register(&conn_callbacks);

    bas_init();
    fhr_init();

    const struct bt_data ad[] = {
        BT_DATA_BYTES(BT_DATA_FLAGS, (BT_LE_AD_GENERAL | BT_LE_AD_NO_BREDR)),
        BT_DATA(BT_DATA_NAME_COMPLETE, CONFIG_BT_DEVICE_NAME, sizeof(CONFIG_BT_DEVICE_NAME) - 1),
    };

    err = bt_le_adv_start(BT_LE_ADV_CONN, ad, ARRAY_SIZE(ad), NULL, 0);
    if (err) {
        printk("Advertising failed to start (err %d)\n", err);
    } else {
        printk("Advertising as %s\n", CONFIG_BT_DEVICE_NAME);
    }
}
```
